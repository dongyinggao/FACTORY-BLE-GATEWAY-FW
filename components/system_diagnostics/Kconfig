## components/system_diagnostics/Kconfig
```kconfig
menu "System diagnostics"

config SYSTEM_DIAGNOSTICS_TASKS_ENABLED
    bool "Enable task and CPU diagnostics"
    default n
    select FREERTOS_USE_TRACE_FACILITY
    select FREERTOS_GENERATE_RUN_TIME_STATS
    help
        Enables task state, cumulative CPU runtime share, and stack
        high-water-mark output. Enable this in diagnostic firmware builds.

endmenu
```

## main/Kconfig.projbuild
```kconfig
menu "BLE Gateway diagnostics"

config BLE_GATEWAY_STRESS_TEST_ENABLED
    bool "Enable the stress console command"
    default n
    help
        Enables the `stress` command, which injects synthetic BLE reports into
        the same queue used by the scanner. It intentionally creates test CSV
        and MQTT events, so enable it only in a diagnostic firmware build.

endmenu
```
